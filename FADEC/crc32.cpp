/**
 * @copyright   Николай Крашенинников
 * @project     Измерительный комплекс СУ
 * @file        crc32.cpp
 * @brief       Алгоритм подсчета CRC32, файл реализации.
 *
 * $Revision: 54 $
 * $Author: Николай $
 * $Date:: 2015-11-07 14:37:30#$
 */

#include "crc32.h"

/**
 * Подсчет контольной суммы по массиву данных.
 * Внутренний алгоритм подсчета контрольной суммы, описание недоступно.
 * Written by Christopher Andrews.
 * CRC algorithm generated by pycrc, MIT licence ( https://github.com/tpircher/pycrc ).
 *
 * @param[in] arr Указатель на массив данных.
 * @param[in] sz Размер массива.
 * @return Подсчитанная CRC32.
 */
static unsigned long crc32(const byte *arr, size_t len);

/**
 * Подсчет контольной суммы по массиву данных.
 */
unsigned long crc32_calc(const byte *arr, size_t sz)
{
    if (sz < 4 || arr == NULL) {
        return 0;
    } else {
        return crc32(arr, sz);
    }
}

/**
 * Проверка контрольной суммы массива данных.
 */
bool crc32_check(const byte *arr, size_t sz)
{
    if (sz < 8 || arr == NULL) {
        return false;
    }

    unsigned long crc = crc32(arr, sz - 4);

    if (crc != *((unsigned long *)&arr[sz - 4])) {
        return false;
    } else {
        return true;
    }
}

/**
 * Подсчет контольной суммы по массиву данных.
 */
static unsigned long crc32(const byte *arr, size_t len)
{
    const unsigned long crc_table[16] PROGMEM = {
        0x00000000, 0x1db71064, 0x3b6e20c8, 0x26d930ac,
        0x76dc4190, 0x6b6b51f4, 0x4db26158, 0x5005713c,
        0xedb88320, 0xf00f9344, 0xd6d6a3e8, 0xcb61b38c,
        0x9b64c2b0, 0x86d3d2d4, 0xa00ae278, 0xbdbdf21c
    };

    unsigned long crc = ~0L;

    for (size_t i = 0; i < len; ++i) {
        crc = crc_table[(crc ^ arr[i]) & 0x0f] ^ (crc >> 4);
        crc = crc_table[(crc ^ (arr[i] >> 4)) & 0x0f] ^ (crc >> 4);
        crc = ~crc;
    }
    return crc;
}
